## firmware/components/display_board/Kconfig
```kconfig
menu "Display board"

choice DISPLAY_BOARD
    prompt "Touchscreen device"
    default DISPLAY_BOARD_METALIO_CLAW4

    config DISPLAY_BOARD_METALIO_CLAW4
        bool "MetalioClaw4 (ESP32-P4 + ESP32-C5, 720x720)"

    config DISPLAY_BOARD_M5STACK_TAB5
        bool "M5Stack Tab5 (ESP32-P4 + ESP32-C6, 720x1280)"
endchoice

choice CLAW4_LCD
    prompt "MetalioClaw4 LCD module"
    depends on DISPLAY_BOARD_METALIO_CLAW4
    default CLAW4_LCD_NV3051F

    config CLAW4_LCD_NV3051F
        bool "Production NV3051F / TRULY HE396-040T2BZZ"

    config CLAW4_LCD_FL7707N
        bool "Alternative FL7707N module"
endchoice

config DISPLAY_BOARD_BACKLIGHT_PERCENT
    int "Initial display backlight (%)"
    range 0 100
    default 70

endmenu
```

## firmware/main/Kconfig.projbuild
```kconfig
menu "P4 Native Display"
    config P4_STREAM_WIDTH
        int "AirPlay requested width (sender can override)"
        range 320 1280
        default 640
    config P4_STREAM_HEIGHT
        int "AirPlay requested height (sender can override)"
        range 240 1280
        default 360
    config P4_STREAM_FPS
        int "AirPlay requested maximum FPS"
        range 1 30
        default 10
    config P4_DISPLAY_WIDTH_MM
        int "AirPlay display physical width in millimeters (0 = unknown)"
        range 0 2000
        default 71 if DISPLAY_BOARD_METALIO_CLAW4
        default 0
    config P4_DISPLAY_HEIGHT_MM
        int "AirPlay display physical height in millimeters (0 = unknown)"
        range 0 2000
        default 71 if DISPLAY_BOARD_METALIO_CLAW4
        default 0
    config P4_FRAME_QUEUE_BYTES
        int "Compressed frame queue memory budget"
        range 1048576 8388608
        default 4194304
    config P4_INPUT_ABSOLUTE
        bool "Expose experimental absolute pointer mode in on-device menu"
        default n
        help
            macOS chooses the target display. This is not Sidecar direct touch.
            Start with a mirrored/single display, verify corners, then calibrate.
endmenu
```

## firmware/sdkconfig.defaults
```kconfig
CONFIG_IDF_TARGET="esp32p4"
CONFIG_COMPILER_OPTIMIZATION_PERF=y
CONFIG_FREERTOS_HZ=1000
CONFIG_ESP_MAIN_TASK_STACK_SIZE=8192
CONFIG_SPIRAM=y
CONFIG_SPIRAM_USE_MALLOC=y
CONFIG_SPIRAM_MALLOC_ALWAYSINTERNAL=16384
CONFIG_SPIRAM_MALLOC_RESERVE_INTERNAL=98304
CONFIG_PARTITION_TABLE_CUSTOM=y
CONFIG_PARTITION_TABLE_CUSTOM_FILENAME="partitions.csv"
CONFIG_LWIP_MAX_SOCKETS=20
CONFIG_LWIP_TCP_RECVMBOX_SIZE=32
CONFIG_LWIP_TCP_WND_DEFAULT=65534
CONFIG_LWIP_TCP_SND_BUF_DEFAULT=32768
CONFIG_LWIP_TCPIP_TASK_STACK_SIZE=4096
CONFIG_MBEDTLS_HARDWARE_AES=y
CONFIG_BT_ENABLED=y
CONFIG_BT_CONTROLLER_DISABLED=y
CONFIG_BT_BLUEDROID_ENABLED=n
CONFIG_BT_NIMBLE_ENABLED=y
CONFIG_BT_NIMBLE_TRANSPORT_UART=n
CONFIG_BT_NIMBLE_MAX_CONNECTIONS=1
CONFIG_BT_NIMBLE_MAX_BONDS=3
CONFIG_BT_NIMBLE_NVS_PERSIST=y
CONFIG_BT_NIMBLE_ROLE_CENTRAL=n
CONFIG_BT_NIMBLE_ROLE_OBSERVER=n
CONFIG_BT_NIMBLE_SM_SC=y
# IDF 5.5.4's TinyCrypt ECC path is incompatible with P4 key generation.
# Use the supported backend while preserving Secure Connections and bonding.
CONFIG_BT_NIMBLE_CRYPTO_STACK_MBEDTLS=y
CONFIG_ESP_HOSTED_ENABLE_BT_NIMBLE=y
CONFIG_ESP_HOSTED_NIMBLE_HCI_VHCI=y
CONFIG_ESP_WIFI_REMOTE_ENABLED=y
CONFIG_ESP_WIFI_REMOTE_LIBRARY_HOSTED=y
CONFIG_HTTPD_MAX_REQ_HDR_LEN=1024
CONFIG_HTTPD_MAX_URI_LEN=128
CONFIG_P4_STREAM_WIDTH=640
CONFIG_P4_STREAM_HEIGHT=360
CONFIG_P4_STREAM_FPS=10
```
